## components/midi_ethernet/Kconfig
```kconfig
menu "MIDI Ethernet Configuration"

    choice MIDI_ETH_IP_MODE
        prompt "Ethernet IP Configuration Mode"
        default MIDI_ETH_IP_STATIC
        help
            Select how Ethernet gets its IP address:
            - Static: For direct PC connection
            - DHCP: For connection via router

        config MIDI_ETH_IP_STATIC
            bool "Static IP (Direct PC Connection)"
            help
                Use static IP for direct connection to PC.

        config MIDI_ETH_IP_DHCP
            bool "DHCP (Router Connection)"
            help
                Get IP address automatically from router via DHCP.
                Suitable for connecting to existing network.
    endchoice

    config MIDI_ETH_STATIC_IP
        string "Static IP Address"
        depends on MIDI_ETH_IP_STATIC
        default "192.168.50.2"
        help
            Static IP address for Ethernet interface.

    config MIDI_ETH_STATIC_NETMASK
        string "Static Netmask"
        depends on MIDI_ETH_IP_STATIC
        default "255.255.255.0"
        help
            Netmask for static IP configuration.

    config MIDI_ETH_STATIC_GATEWAY
        string "Static Gateway"
        depends on MIDI_ETH_IP_STATIC
        default "192.168.50.1"
        help
            Gateway address.

    config MIDI_ETH_DISABLE_WIFI_ON_DHCP
        bool "Disable WiFi when Ethernet gets DHCP"
        depends on MIDI_ETH_IP_DHCP
        default n
        help
            Automatically disable WiFi if Ethernet gets DHCP address
            on the same subnet as WiFi. This prevents routing conflicts.

endmenu
```

## components/midi_network/Kconfig
```kconfig
menu "MIDI Network Configuration"

    config MIDI_NET_PORT
        int "MIDI Network Port"
        default 5004
        help
            UDP port number for MIDI Network sessions.
            
    config MIDI_NET_MAX_SESSIONS
        int "Maximum MIDI Network Sessions"
        default 4
        help
            Maximum number of simultaneous MIDI Network sessions.

    config MIDI_NET_BROADCAST_RX
        bool "Broadcast received UMP packets to other sessions"
        default n
        help
            If enabled, UMP packets received from one MIDI Network session
            will be broadcast to all other active sessions.

endmenu
```

## components/midi_wifi/Kconfig
```kconfig
menu "MIDI WiFi Configuration"

    config MIDI_WIFI_SSID
        string "WiFi SSID"
        help
            SSID (network name) to connect to.

    config MIDI_WIFI_PASSWORD
        string "WiFi Password"
        help
            WiFi password (WPA or WPA2).
endmenu
```

## main/Kconfig.projbuild
```kconfig
menu "MIDI Cube Configuration"

    config MIDI_ENABLE_USBD
        bool "Enable USB MIDI Device"
        default y
        help
            Enables USB MIDI device interface.

    config MIDI_ENABLE_UART
        bool "Enable UART (DIN) MIDI"
        default y
        help
            Enables MIDI over DIN 5-pin UART.

    config MIDI_ENABLE_WIFI
        bool "Enable Network MIDI 2.0 over Wi-Fi"
        default y
        help
            Enables Network MIDI 2.0 over Wi-Fi.

    config MIDI_ENABLE_ETHERNET
        bool "Enable Network MIDI 2.0 over Ethernet"
        default y
        help
            Enables Network MIDI 2.0 over Ethernet.

endmenu
```
