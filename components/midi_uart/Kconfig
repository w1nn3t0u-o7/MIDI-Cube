## components/midi_uart/Kconfig
```kconfig
menu "MIDI UART Configuration"

    config MIDI_UART_PORT_NUM
        int "UART Port Number"
        default 1
        range 0 2
        help
            ESP32-S3 UART port number for MIDI (0, 1, or 2).
            Note: UART0 is typically used for console/debug.
            Recommended: UART1 or UART2 for MIDI.

    config MIDI_UART_TX_PIN
        int "MIDI TX Pin (GPIO)"
        default 17
        range 0 48
        help
            GPIO pin for MIDI OUT (TX). Default: GPIO17

    config MIDI_UART_RX_PIN
        int "MIDI RX Pin (GPIO)"
        default 16
        range 0 48
        help
            GPIO pin for MIDI IN (RX). Default: GPIO16

    config MIDI_UART_RX_BUFFER_SIZE
        int "RX Ring Buffer Size (bytes)"
        default 1024
        range 256 4096
        help
            UART RX buffer size. MIDI byte stream buffer.
            Larger = more burst tolerance, more RAM usage.

    config MIDI_UART_TX_BUFFER_SIZE
        int "TX Ring Buffer Size (bytes)"
        default 1024
        range 256 4096
        help
            UART TX buffer size for outgoing MIDI data.

    config MIDI_UART_EVENT_QUEUE_SIZE
        int "UART Event Queue Size"
        default 20
        range 10 50
        help
            Number of UART events that can be queued.

    config MIDI_UART_TASK_STACK_SIZE
        int "MIDI UART Task Stack Size (bytes)"
        default 4096
        range 2048 8192
        help
            Stack size for MIDI UART processing task.

    config MIDI_UART_TASK_PRIORITY
        int "MIDI UART Task Priority"
        default 10
        range 5 20
        help
            FreeRTOS task priority. Higher = more CPU time.
            10 = High priority (audio/MIDI level)

    config MIDI_UART_USE_OPTOCOUPLER
        bool "Hardware uses optocoupler on RX"
        default y
        help
            Enable if your MIDI IN circuit uses 6N138/6N137 optocoupler.
            Affects timing characteristics slightly.

endmenu
```

## components/midi_usb/Kconfig
```kconfig
menu "MIDI USB Configuration"

    choice MIDI_USB_MODE
        prompt "USB Operating Mode"
        default MIDI_USB_MODE_AUTO
        help
            Select USB operating mode for MIDI interface.
        
        config MIDI_USB_MODE_AUTO
            bool "Automatic (detect on boot)"
            help
                Automatically detect USB mode based on ID pin.
                Device mode if USB connected to host.
                Host mode if MIDI device connected.
        
        config MIDI_USB_MODE_DEVICE_ONLY
            bool "Device Only"
            help
                Always operate as USB device (for PC connection).
        
        config MIDI_USB_MODE_HOST_ONLY
            bool "Host Only"
            help
                Always operate as USB host (for MIDI keyboard/controller).
    endchoice

    config MIDI_USB_DEVICE_VID
        hex "USB Vendor ID (Device Mode)"
        default 0x303A
        help
            Espressif VID. Change if you have your own.

    config MIDI_USB_DEVICE_PID
        hex "USB Product ID (Device Mode)"
        default 0x4002
        help
            Product ID for your MIDI interface.

    config MIDI_USB_MANUFACTURER
        string "Manufacturer String"
        default "Your Company"

    config MIDI_USB_PRODUCT
        string "Product String"
        default "MIDI Cube"

    config MIDI_USB_SERIAL
        string "Serial Number"
        default "123456"

    config MIDI_USB_SUPPORT_MIDI2
        bool "Enable MIDI 2.0 Support (UMP)"
        default y
        help
            Enable USB MIDI 2.0 with Universal MIDI Packet support.
            Provides both MIDI 1.0 (Alternate Setting 0) and
            MIDI 2.0 (Alternate Setting 1) interfaces.

    config MIDI_USB_MAX_CABLES
        int "Maximum Virtual Cables"
        default 1
        range 1 16
        help
            Number of virtual MIDI cables (1-16).
            Each cable = separate MIDI stream.

    config MIDI_USB_RX_BUFFER_SIZE
        int "RX Buffer Size (packets)"
        default 32
        range 8 128
        help
            Number of MIDI packets to buffer on RX.

    config MIDI_USB_TX_BUFFER_SIZE
        int "TX Buffer Size (packets)"
        default 32
        range 8 128
        help
            Number of MIDI packets to buffer on TX.

endmenu
```
